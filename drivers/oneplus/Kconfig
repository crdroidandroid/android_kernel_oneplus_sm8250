## drivers/oneplus/misc/Kconfig
```kconfig
config PROJECT_INFO
    bool "detect project info"
    default n
    help
      detect projcet info  If unsure, say n.

config OEM_BOOT_MODE
    bool "detect oem boot mode"
    default n
    help
        detect oem boot mode  If unsure, say y.
```
